## conf/layer.conf
```bitbake
# We have a conf and classes directory, append to BBPATH
BBPATH .= ":${LAYERDIR}"

# We have a recipes directory, add to BBFILES
BBFILES += "${LAYERDIR}/recipes-*/*.bb ${LAYERDIR}/recipes-*/*.bbappend"
BBFILES += "${LAYERDIR}/recipes-*/*/*.bb ${LAYERDIR}/recipes-*/*/*.bbappend"
BBFILES += "${LAYERDIR}/recipes-*/*/*/*.bb ${LAYERDIR}/recipes-*/*/*/*.bbappend"

LINKDROID_BASE := '${@os.path.normpath("${LAYERDIR}/../")}'
META-LINKDROID-BASE := '${@os.path.normpath("${LAYERDIR}/")}'

BBFILE_COLLECTIONS += "linkdroid-layer"
BBFILE_PATTERN_linkdroid-layer := "^${LAYERDIR}/"
BBFILE_PRIORITY_linkdroid-layer = "77"

OEA-META-LINKDROID-BASE := '${@os.path.normpath("${LAYERDIR}/")}'

#QEMU_TARGETS ?= "aarch64"
QEMU_TARGETS = ""

BBMASK += " meta-oe-alliance/meta-oe/recipes-multimedia/ffmpeg/ "
```

## conf/machine/alien5.conf
```bitbake
#@TYPE: Machine
#@NAME: 
#@DESCRIPTION: Machine configuration for the Amiko Alien5 

MACHINE_NAME = "Alien5"
BRAND_OEM = "LinkDroid"
MACHINE_BRAND = "Amiko"

#GST_VERSION = "0.10"
GST_VERSION = "1.0"

MTD_BLACK  = "mmcblk0"
KERNEL_FILE = "kernel.itb"
ROOTFS_FILE = "rootfs.tar.bz2"


# Amlogic defaults
require conf/machine/include/amlogic.inc
require conf/machine/include/arm/arch-armv8.inc
#require conf/machine/include/soc-family.inc


IMAGE_CLASSES += "sdcard_image-alien5"
SDCARD_ROOTFS ?= "${DEPLOY_DIR_IMAGE}/${IMAGE_NAME}.rootfs.ext4"
IMAGE_FSTYPES ?= "ext4 alien5sdimg"
#IMAGE_ROOTFS_SIZE = "976562"
IMAGE_ROOTFS_SIZE = "476562"
IMAGE_EXTRA_SPACE = "0"
IMAGE_OVERHEAD_FACTOR = "1.0"

BB_HASH_IGNORE_MISMATCH = "1"

# Serial console to be used
SERIAL_CONSOLE = "115200 ttyS0"

PREFERRED_PROVIDER_virtual/kernel = "linux-a4"
PREFERRED_VERSION_linux-a4 = "3.14%"
#PREFERRED_VERSION_linux-libc-headers = "3.14"
PREFERRED_VERSION_linux-libc-headers = "3.14.79"

KERNEL_CLASSES += "aarch64-fitimage"
#KERNEL_CLASSES += "kernel-fitimage"
KERNEL_IMAGETYPE = "fitImage"
KERNEL_DEVICETREE ?= "alien5.dtb"

UBOOT_ENTRYPOINT = "0x01080000"
UBOOT_LOADADDRESS = "0x01080000"

INITRAMFS_IMAGE = "amlogic-initramfs"

MACHINE_FEATURES = "bluetooth usbhost vfat alsa dvb-c legacykernel nolcd hdmicec fb wifi "

MACHINE_ESSENTIAL_EXTRA_RDEPENDS = "\
    a5-shutdown \
    aml-autoscript \
    \
    mali-${MACHINE} \
    ${@bb.utils.contains('GST_VERSION', '1.0', 'gst-amlavsink1 ', 'gst-amlavsink gst-amlavout gst-fluendo-mpegdemux gst-ffmpeg', d)} \
    gst-app \
    libamplayer \
    libamavutils \
    libamadec \
    libamcodec \
    amlsetfb \
    \
    kernel-modules \
    amremote \
    opengl-amlogic \
    \
    a5stb \
    libavlib-audio-so \
    libmad \
    a5extra \
    " 


DVBPROVIDER = "kernel"

### TODO:     8189es builitin with cfg80211
MACHINE_ESSENTIAL_EXTRA_RRECOMMENDS = "\
     \
    kernel-module-cdfs \
    kernel-module-sysfillrect \
    kernel-module-syscopyarea \
    kernel-module-mceusb \
    kernel-module-rc-core \
    kernel-module-CH341 \
    kernel-module-rfcomm \
    kernel-module-hidp \
    kernel-module-bluetooth \
    kernel-module-6lowpan-iphc \
    kernel-module-libcrc32c \
    kernel-module-xfs \
    pcsc-lite \
    kernel-module-8189es \
    kernel-module-cfg80211 \
    "

MACHINE_EXTRA_RRECOMMENDS += " \
    lkdosth \
    libdvbcsa \
    ntfs-3g \
    parted \
    cnim \
    "

KERNEL_MODULE_AUTOLOAD += " \
    se2io_se \
    ampanel \
    a5stb \ 
    mali \
    rfcomm \
    hidp \
    bluetooth \
    6lowpan-iphc \
    libcrc32c \
    mceusb \
    rc-core \
    cfg80211 \
    8189es \   
"


# We know about rtc
include conf/machine/include/build-extras.inc
```

## conf/machine/include/amlogic.inc
```bitbake
MACHINE_ESSENTIAL_EXTRA_RDEPENDS += " ${@bb.utils.contains('MACHINE_FEATURES', 'fb', 'amlsetfb', '', d)}"

PREFERRED_PROVIDER_virtual/libgles1 = "opengl-amlogic"
PREFERRED_PROVIDER_virtual/libgles2 = "opengl-amlogic"
PREFERRED_PROVIDER_virtual/egl = "opengl-amlogic"
PREFERRED_PROVIDER_virtual/kodi-aml = "kodi-aml"
PREFERRED_PROVIDER_kodi-aml = "kodi-aml"
PREFERRED_VERSION_kodi = "17.6"

#PREFERRED_VERSION_ffmpeg = "3.2.4"
#PREFERRED_VERSION_ffmpeg = "3.4.2"
#PREFERRED_PROVIDER_x264 = "ffmpeg"

### PREFERRED_PROVIDER_virtual/kernel = "linux-amlogic"
PREFERRED_PROVIDER_jpeg = "libjpeg-turbo"
PREFERRED_PROVIDER_jpeg-native = "libjpeg-turbo-native"

EXTRA_OECONF_append_pn-enigma2 = " --with-alsa --with-alsacard=hw:0 --with-alsamixer=Master --with-fbdev=/dev/fb0 --with-lcddev=/dev/null --with-amlogic"
DEPENDS_append_pn-enigma2 = " libdvbcsa libamcodec libamadec "
EXTRA_OECONF_append_pn-tuxtxt-enigma2 = " --with-fbdev=/dev/fb0"
#EXTRA_OECONF_append_pn-tuxtxt-enigma2 = " --with-fbdev=/dev/fb2"
CC_append_pn-showiframe = " -DHAVE_AMLOGIC -I${STAGING_INCDIR}/amlogic/amcodec -lamcodec"
DEPENDS_append_pn-showiframe = " libamcodec"

# Add "MACHINEBUILD" override for recipes
MACHINEOVERRIDES =. "${@['', '${MACHINEBUILD}:']['${MACHINEBUILD}' != '']}"

BBMASK += "meta-vuplus/recipes-graphics/"
BBMASK += "meta-fulan/recipes-graphics/"
BBMASK += "meta-vuplus/recipes-webkit/"
BBMASK += "../openembedded-core/meta/recipes-multimedia/x264/"
BBMASK += "meta-pure2/recipes-oe-alliance/recipes-multimedia/ffmpeg/"
```
